## Kconfig
```kconfig
mainmenu "Project Configuration"

rsource "kernel/Kconfig"

config TEST
	bool "Test Option"
	help
		Test option
```

## configs/default_defconfig
```kconfig
#
# Build options
#
# CONFIG_LTO is not set
CONFIG_STACK_CANARIES=y

#
# Sanitizers
#
CONFIG_UBSAN=y
# end of Sanitizers

CONFIG_DEBUG=y
CONFIG_BUILD_TYPE_DEBUG=y
# CONFIG_BUILD_TYPE_RELEASE is not set
# CONFIG_BUILD_TYPE_MINSIZEREL is not set
# end of Build options

#
# General Options
#
CONFIG_BOOT_BANNER=y
# end of General Options

# CONFIG_TEST is not set
```

## kernel/Kconfig
```kconfig
rsource "$ARCH_DIR/Kconfig"
rsource "vm/Kconfig"
rsource "io/Kconfig"

menu "Build options"
	config LTO
		bool "Enable LTO"
		default n
		help
			Enable Link-time-optimization for the kernel

	config STACK_CANARIES
		bool "Enable Stack canaries"
		default y
		help
			Enable the stack protector code

	menu "Sanitizers"
		config UBSAN
			bool "Enable UBSAN"
			default n
			help
				Enable the Undefined-Behaviour sanitizer
	endmenu

	config DEBUG
		bool "Enable Debugging"
		default y
		help
			Enable debug support

	choice
		prompt "Build type"
		default BUILD_TYPE_DEBUG
	
	config BUILD_TYPE_DEBUG
		bool "Debug"

	config BUILD_TYPE_DEBUG_OPTIMIZED
		bool "DebugOptimized"
	
	config BUILD_TYPE_RELEASE
		bool "Release"
	
	config BUILD_TYPE_MINSIZEREL
		bool "MinSizeRel"

	config BUILD_TYPE_FASTFLAGSREL
		bool "FastFlagsRel"
	
	endchoice
endmenu

menu "General Options"
	config BOOT_BANNER
		bool "Print Boot Banner"
		default y
	
	config LOG_TIMESTAMPS
		bool "Timestamp logs"
		default y

	config MAX_NR_CPUS
		int "Number of supported CPUs"
		range 1 4096
		default 256
		help
			Maximum number of supported CPUs. Has to be power of two.
endmenu
```

## kernel/arch/x86_64/Kconfig
```kconfig
menu "Interrupts"
	config LAZY_IPL
		bool "Enable lazy cr8 update"
		default y
		help
			Especially helpful when running under virtualization
endmenu

menu "Boot"
	config EARLYFB
		bool "Enable Early Framebuffer output"
		default n
endmenu

config ARCH_HAS_ACPI
	bool
	default y

config ARCH_SUPPORTS_GENERIC_PAGEMAP
	bool
	default y

config X86
	bool
	select ACPI_ENABLED
	select USE_GENERIC_PAGEMAP
	default y
```

## kernel/io/Kconfig
```kconfig
config ACPI_ENABLED
	bool "Enable support for ACPI"
	depends on ARCH_HAS_ACPI
	default y
```

## kernel/vm/Kconfig
```kconfig
menu "Memory"

config FREELIST_ORDERS
	int "Maximum buddy allocator order"
	range 4 19
	default 11
	help
		The number of orders in the buddy allocator's free lists.

		The maximum physically-contiguous allocation size will be PAGE_SIZE * (1 << (FREELIST_ORDERS - 1))

endmenu
```
